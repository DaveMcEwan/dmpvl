
module top (
  input  i_pin_clk_16MHz, // TinyFPGA-BX oscillator

  inout  b_pin_usb_p,     // USB d+
  inout  b_pin_usb_n,     // USB d-
  output o_pin_pu,        // USB host-detect pull-up

  input  [3:0] i_pin_probe, // XY probes

  output [1:0] o_pin_pwm // Result/output LEDs
);

// PLL generated by icepll.
wire clk_48MHz;
wire pllLocked;
pll48 u_pll48 (
  .clock_in   (i_pin_clk_16MHz),
  .clock_out  (clk_48MHz),
  .locked     (pllLocked)
);

wire rst;
fpgaReset u_rst (
  .i_clk        (clk_48MHz),
  .i_pllLocked  (pllLocked),
  .o_rst        (rst)
);


wire usb_p;
wire usb_n;
wire usbOutputEnable; // Select GPIO input/output mode.
wire usbTx_p;
wire usbTx_n;
wire usbRx_p;
wire usbRx_n;

// Supply receiver with J line state when transmitting.
assign usbRx_p = usbOutputEnable ? 1'b1 : usb_p;
assign usbRx_n = usbOutputEnable ? 1'b0 : usb_n;

SB_IO #(
  .PIN_TYPE (6'b101001), // [5:2]->PIN_OUTPUT_TRISTATE, [1:0]->PIN_INPUT
  .PULLUP   (1'b0)
) iobuf_usbp (
  .PACKAGE_PIN    (b_pin_usb_p),
  .OUTPUT_ENABLE  (usbOutputEnable),
  .D_OUT_0        (usbTx_p),
  .D_IN_0         (usb_p)
);

SB_IO #(
  .PIN_TYPE (6'b101001), // [5:2]->PIN_OUTPUT_TRISTATE, [1:0]->PIN_INPUT
  .PULLUP   (1'b0)
) iobuf_usbn (
  .PACKAGE_PIN    (b_pin_usb_n),
  .OUTPUT_ENABLE  (usbOutputEnable),
  .D_OUT_0        (usbTx_n),
  .D_IN_0         (usb_n)
);

assign o_pin_pu = 1'b1;


wire [1:0] resultPwm;
usbfsBpCorrelator #(
  .USBFS_VIDPID_SQUAT     (1),
  .USBFS_ACM_NOT_GENERIC  (1),
  .USBFS_MAX_PKT          (16), // in {8,16,32,64}. wMaxPacketSize
  .N_PROBE                (4), // 2..64
  .N_PAIR                 (2), // 1..8
  .MAX_WINDOW_LENGTH_EXP  (16),
  .MAX_SAMPLE_PERIOD_EXP  (15),
  .MAX_SAMPLE_JITTER_EXP  (8),
  .WINDOW_PRECISION       (8), // 1 < p <= MAX_WINDOW_LENGTH_EXP
  .METRIC_PRECISION       (16),
  .PKTFIFO_DEPTH          (50)
) u_usbfsBpCorrelator (
  .i_clk_48MHz        (clk_48MHz),
  .i_rst              (rst),
  .i_cg               (1'b1),

  // USB {d+, d-}, output enable.
  .i_dp               (usbRx_p),
  .i_dn               (usbRx_n),
  .o_dp               (usbTx_p),
  .o_dn               (usbTx_n),
  .o_oe               (usbOutputEnable),

  .i_probe            (i_pin_probe),

  .o_pwm              (resultPwm)
);


localparam LED_BLINKONLY = 0;
generate if (LED_BLINKONLY != 0) begin
  reg [23:0] ledCounter_q;
  always @(posedge clk_48MHz)
    if (rst)
      ledCounter_q <= 24'd0;
    else
      ledCounter_q <= ledCounter_q + 24'd1;
  assign o_pin_pwm = ledCounter_q[23:22];
end else begin
  assign o_pin_pwm = resultPwm;
end endgenerate

endmodule
